## conf/layer.conf
```bitbake
#
# Raspberry Pi BSP Layer
#

# We have a conf and classes directory, add to BBPATH
BBPATH .= ":${LAYERDIR}"

# We have a packages directory, add to BBFILES
BBFILES := "${BBFILES} ${LAYERDIR}/recipes-*/*/*.bb \
            ${LAYERDIR}/recipes-*/*/*.bbappend \
            ${LAYERDIR}/classes/*.bbclass"

BBFILE_COLLECTIONS += "rpi"
BBFILE_PATTERN_rpi := "^${LAYERDIR}/"
BBFILE_PRIORITY_rpi = "7"

# Let the "No recipes available for: pkg.bbappend" be WARNINGS until we
# cleanup the unused bbappend.
BB_DANGLINGAPPENDS_WARNONLY ?= "true"

# This should only be incremented on significant changes that will
# cause compatibility issues with other layers
LAYERVERSION_rpi = "1"

# All BSP's require "core", include "wrlinux" for Wind River additions
# and "wr-template" for layers which contain templates.
LAYERDEPENDS_rpi = "core wrlinux wr-template"

# Since LTS-18 we need to list the layer's Yocto compatibility.
LAYERSERIES_COMPAT_rpi = "scarthgap"

# Since LTS-24, patches need to have an upstream status in their commit
# messages. As this layer contains a lot of upstream patches which do
# not have this status, ignore the errors -- but only from this layer.
ERROR_QA:remove:rpi = "patch-status"
```

## conf/machine/include/tune-arm1176jzf-s.inc
```bitbake
DEFAULTTUNE ?= "armv6"

require conf/machine/include/arm/arch-armv6.inc

TUNEVALID[arm1176jzfs] = "Enable arm1176jzfs specific processor optimizations"
TUNE_CCARGS += "${@bb.utils.contains("TUNE_FEATURES", "arm1176jzfs", "-mtune=arm1176jzf-s", "", d)}"
TUNE_CCARGS += "${@bb.utils.contains("TUNE_FEATURES", "vfp", "-mfpu=vfp", "", d)}"

AVAILTUNES += "arm1176jzfs arm1176jzfshf"
ARMPKGARCH:tune-arm1176jzfs = "arm1176jzfs"
ARMPKGARCH:tune-arm1176jzfshf = "arm1176jzfs"
TUNE_FEATURES:tune-arm1176jzfs = "${TUNE_FEATURES:tune-armv6} arm1176jzfs"
TUNE_FEATURES:tune-arm1176jzfshf = "${TUNE_FEATURES:tune-arm1176jzfs} callconvention-hard"
PACKAGE_EXTRA_ARCHS:tune-arm1176jzfs = "${PACKAGE_EXTRA_ARCHS:tune-armv6}"
PACKAGE_EXTRA_ARCHS:tune-arm1176jzfshf = "${PACKAGE_EXTRA_ARCHS:tune-armv6hf} arm1176jzfshf-vfp"
```

## conf/machine/rpi-common.inc
```bitbake
#@TYPE: Machine inc.
#@NAME: Raspberry Pi common configuration settings

# Use the standard kernel
PREFERRED_PROVIDER_virtual/kernel = "linux-yocto"

SOC_FAMILY = "rpi"
include conf/machine/include/soc-family.inc

# The RPi does not have a real-time clock
MACHINE_FEATURES = "apm sdio vfat ext3 usbhost keyboard screen"
MACHINE_FEATURES_BACKFILL_CONSIDERED = "rtc"

# The bootloader looks for a bzImage file
KERNEL_IMAGETYPE = "Image"

# Use the ARM serial interface for a console
SERIAL_CONSOLE = "115200 ttyAMA0"

# Generate a tar archive of the rootfs by default
IMAGE_FSTYPES ?= "tar.bz2"
```

## conf/machine/rpi.conf
```bitbake
#@TYPE: Machine
#@NAME: Raspberry Pi
#@DESCRIPTION: Machine configuration for the original Raspberry Pi

# Broadcom BCM2835 SoC has an ARM v6 core
DEFAULTTUNE = "arm1176jzfshf"
require conf/machine/include/tune-arm1176jzf-s.inc

# Broadcom VideoCore 4 Memory Allocation
VC4_CMA_SIZE = "cma-64"

# Use the ARM serial interface for a console
SERIAL_CONSOLE = "115200 ttyAMA0"

# Everything else is common to all RPi boards
require rpi-common.inc
```

## conf/machine/rpi.inc
```bitbake
#@TYPE: Machine inc.
#@NAME: rpi layer

PREFERRED_PROVIDER_virtual/kernel_rpi = "linux-yocto"

DEFAULTTUNE = "arm1176jzfshf"
require conf/machine/include/tune-arm1176jzf-s.inc

SOC_FAMILY = "rpi"
include conf/machine/include/soc-family.inc

MACHINE_FEATURES = "apm sdio vfat ext3 usbhost keyboard screen"
MACHINE_FEATURES_BACKFILL_CONSIDERED = "rtc"

KERNEL_IMAGETYPE = "Image"

SERIAL_CONSOLE = "115200 ttyAMA0"

VC4_CMA_SIZE_rpi = "cma-64"

IMAGE_FSTYPES ?= "tar.bz2"
```

## conf/machine/rpi2.conf
```bitbake
#@TYPE: Machine
#@NAME: Raspberry Pi
#@DESCRIPTION: Machine configuration for the Raspberry Pi 2

# Broadcom BCM2836 SoC has an ARM v7 core
DEFAULTTUNE = "cortexa7thf-neon-vfpv4"
require conf/machine/include/tune-cortexa7.inc

# Broadcom VideoCore 4 Memory Allocation
VC4_CMA_SIZE = "cma-256"

# Everything else is common to all RPi boards
require rpi-common.inc
```

## conf/machine/rpi3-64.conf
```bitbake
#@TYPE: Machine
#@NAME: Raspberry Pi 3
#@DESCRIPTION: Machine configuration for the Raspberry Pi 3

# Broadcom BCM2837 SoC has an ARM v8 core
#DEFAULTTUNE = ""
require conf/machine/include/arm/arch-arm64.inc

# Broadcom VideoCore 4 Memory Allocation
VC4_CMA_SIZE = "cma-256"

# Use the mini-UART serial interface for a console
SERIAL_CONSOLE = "115200 ttyS0"

# Everything else is common to all RPi boards
require rpi-common.inc
```
